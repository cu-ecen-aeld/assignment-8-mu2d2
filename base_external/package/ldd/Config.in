## base_external/package/ldd/Config.in
```kconfig
config BR2_PACKAGE_LDD
	bool "ldd"
	depends on BR2_LINUX_KERNEL
	help
	  Builds and installs the misc-modules and scull kernel modules
	  from the ldd3 (Linux Device Drivers 3rd edition) repository
	  fork at assignment-7-mu2d2.
```
